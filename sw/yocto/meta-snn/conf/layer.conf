## sw/yocto/meta-snn/conf/layer.conf
```bitbake
BBPATH .= ":${LAYERDIR}"
BBFILES += "${LAYERDIR}/recipes-*/*/*.bb ${LAYERDIR}/recipes-*/*/*.bbappend"
BBFILE_COLLECTIONS += "snn"
BBFILE_PATTERN_snn = "^${LAYERDIR}/"
BBFILE_PRIORITY_snn = "10"
LAYERSERIES_COMPAT_snn = "scarthgap styhead walnascar whinlatch"
```
